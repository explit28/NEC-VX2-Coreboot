## board-port/Kconfig
```kconfig
## SPDX-License-Identifier: GPL-2.0-only
# NEC VersaPro VX-2 / LA-C423P. Board hardware initialization remains experimental.

config BOARD_NEC_VERSAPRO_VX2
	select MAINBOARD_USES_IFD_GBE_REGION
	select SOC_INTEL_KABYLAKE
	select BOARD_ROMSIZE_KB_16384
	select SYSTEM_TYPE_LAPTOP
	select HAVE_ACPI_TABLES
	select MAINBOARD_HAS_LIBGFXINIT
	select GFX_GMA_IGNORE_PRESENCE_STRAPS
	select MAINBOARD_HAS_TPM2
	select MEMORY_MAPPED_TPM

if BOARD_NEC_VERSAPRO_VX2

config MAINBOARD_DIR
	default "nec/versapro_vx2"

config MAINBOARD_PART_NUMBER
	default "VersaPro VX-2 LA-C423P"

config MAINBOARD_VERSION
	default "1.0"

config DIMM_MAX
	default 2

config DIMM_SPD_SIZE
	default 512

config NEC_VX2_IGD_OEM_COMPAT
	bool "Experimental NEC VX-2 OEM IGD ACPI compatibility"
	depends on EDK2_GOP_DRIVER && NO_GFX_INIT && !MAINBOARD_USE_LIBGFXINIT
	help
	  Enable the NEC-specific IGD _DSM subset and bind ACPI to the
	  coreboot-owned OpRegion. SWSCI remains unadvertised and its
	  GPE handler is not registered. This option requires the existing
	  EDK2 GOP setup and leaves the Coreboot OpRegion mailbox mask intact.

config NEC_VX2_IGD_DSM_INTEGER_QUERY
	bool "Return the Intel IGD _DSM function bitmap as an integer"
	depends on NEC_VX2_IGD_OEM_COMPAT
	help
	  Test the OEM return type for function zero of the Intel IGD _DSM.
	  The response still advertises only implemented functions. Leave
	  this disabled to return the standard ACPI buffer response.

endif # BOARD_NEC_VERSAPRO_VX2
```

## board-port/Kconfig.name
```kconfig
## SPDX-License-Identifier: GPL-2.0-only

config BOARD_NEC_VERSAPRO_VX2
	bool "VersaPro VX-2 (LA-C423P)"
```

## src/mainboard/nec/versapro_vx2/Kconfig
```kconfig
## SPDX-License-Identifier: GPL-2.0-only
# NEC VersaPro VX-2 / LA-C423P.

config BOARD_NEC_VERSAPRO_VX2
	select MAINBOARD_USES_IFD_GBE_REGION
	select SOC_INTEL_KABYLAKE
	select BOARD_ROMSIZE_KB_16384
	select SYSTEM_TYPE_LAPTOP
	select HAVE_ACPI_TABLES
	select MAINBOARD_HAS_LIBGFXINIT
	select GFX_GMA_IGNORE_PRESENCE_STRAPS
	select MAINBOARD_HAS_TPM2
	select MEMORY_MAPPED_TPM

if BOARD_NEC_VERSAPRO_VX2

config MAINBOARD_DIR
	default "nec/versapro_vx2"

config MAINBOARD_PART_NUMBER
	default "VersaPro VX-2 LA-C423P"

config MAINBOARD_VERSION
	default "1.0"

config DIMM_MAX
	default 2

config DIMM_SPD_SIZE
	default 512

endif # BOARD_NEC_VERSAPRO_VX2
```

## vendor-port/Kconfig
```kconfig
## SPDX-License-Identifier: GPL-2.0-only

if VENDOR_NEC

choice
	prompt "Mainboard model"

source "src/mainboard/nec/*/Kconfig.name"

endchoice

source "src/mainboard/nec/*/Kconfig"

config MAINBOARD_VENDOR
	default "NEC"

endif # VENDOR_NEC
```
